## conf/layer.conf
```bitbake
# We have a conf and classes directory, add to BBPATH
BBPATH .= ":${LAYERDIR}"

# We have recipes-* directories, add to BBFILES
BBFILES += "${LAYERDIR}/recipes-*/*/*.bb \
            ${LAYERDIR}/recipes-*/*/*.bbappend"

BBFILE_COLLECTIONS += "meta-harvey"
BBFILE_PATTERN_meta-harvey = "^${LAYERDIR}/"
BBFILE_PRIORITY_meta-harvey = "7"

LAYERDEPENDS_meta-harvey = "core"
LAYERSERIES_COMPAT_meta-harvey = "thud"
```
